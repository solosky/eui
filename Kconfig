## examples/esp-idf/st7789_240x240/sdkconfig.defaults
```kconfig
CONFIG_IDF_TARGET="esp32s3"
CONFIG_FREERTOS_HZ=1000
CONFIG_EUI_COLOR_DEPTH=16
CONFIG_EUI_MAX_VIEWS=16
CONFIG_EUI_MAX_OVERLAYS=8
CONFIG_EUI_SCENE_MAX=24
CONFIG_EUI_MEM_POOL_SIZE=196608
```
